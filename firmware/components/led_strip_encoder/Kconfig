## firmware/components/led_strip_encoder/Kconfig
```kconfig
menu "LED Strip Encoder"
    config LED_STRIP_ENCODER
        bool "Enable LED strip encoder component"
        default y
endmenu
```

## firmware/sdkconfig.defaults
```kconfig
CONFIG_IDF_TARGET="esp32s3"
# 与常见 8MB SPI Flash 一致；若写 4MB 而芯片为 8MB 会告警且 esptool 只认 header 容量
CONFIG_ESPTOOLPY_FLASHSIZE_8MB=y

# 面包板调试：Mac en0 (192.168.1.x WiFi) 实际 IP；覆盖 Kconfig 默认 192.168.10.26
# 真生产 PCB 不要 commit 此行，或换成其他 sdkconfig.defaults.* 文件单独存放
CONFIG_BBCLAW_ADAPTER_BASE_URL="http://192.168.1.2:18080"
# bb_http_resp_t.body[8192] + 调用链：须大于 8K，否则 main 任务栈溢出（见 bb_cloud_pair_request）
CONFIG_ESP_MAIN_TASK_STACK_SIZE=20480
# LVGL 偶发整屏 SW 合成较慢时给 IDLE 留出余量（默认 5s 可能偏紧）
CONFIG_ESP_TASK_WDT_TIMEOUT_S=10
CONFIG_LOG_DEFAULT_LEVEL_INFO=y

# OTA 分区布局（partitions_ota.csv）：factory 1M + ota_0/ota_1 各 2.5M + resources 1M。
# LVGL 字库 + 应用体积超过 single_app_large 的 1500K 上限，所以 ota_0/ota_1 各预留 2.5M。
# 主固件烧到 ota_0（0x120000），由 otadata 选择启动槽——见 firmware/Makefile 的 flash-ota0 目标。
# CLAUDE.md 也说明：cloud_saas 模式下设备启动后通过 GET /v1/ota/check 拉新版固件。
CONFIG_PARTITION_TABLE_CUSTOM=y
CONFIG_PARTITION_TABLE_CUSTOM_FILENAME="partitions_ota.csv"

# lv_font_conv 默认输出压缩位图；未开启则 get_bitmap 恒为 NULL → 中英文皆方框
CONFIG_LV_USE_FONT_COMPRESSED=y
# 全量 CJK 字库 bitmap 常 >1MB；关闭时 glyph bitmap_index 仅 20 位会溢出错位
CONFIG_LV_FONT_FMT_TXT_LARGE=y

# 待机大屏时钟（仅数字与 ASCII，可与 CJK 并存）
CONFIG_LV_FONT_MONTSERRAT_40=y
CONFIG_LV_FONT_MONTSERRAT_48=y

# SNTP（bb_sntp_start → pool.ntp.org）
CONFIG_LWIP_SNTP_MAX_SERVERS=3

# PSRAM (ESP-PSRAM64H, 8MB Quad SPI)
CONFIG_SPIRAM=y
CONFIG_SPIRAM_MODE_QUAD=y
CONFIG_SPIRAM_SPEED_80M=y
```
