## firmware/src/Kconfig.projbuild
```kconfig
menu "BBClaw"

choice BBCLAW_BOARD_CHOICE
    prompt "Board"
    default BBCLAW_BOARD_BBCLAW
    help
        Select the target hardware board. Each board defines its own pin map,
        audio codec, display bus, and peripheral configuration.

config BBCLAW_BOARD_BREADBOARD
    bool "Breadboard (INMP441 + MAX98357A + SPI ST7789)"
    help
        Default development configuration using discrete modules on a breadboard.

config BBCLAW_BOARD_BBCLAW
    bool "BBClaw custom PCB (battery + rotary encoder + SPI ST7789)"
    help
        Custom BBClaw PCB derived from the breadboard wiring, with battery
        sensing and a rotary encoder with push switch for navigation.

config BBCLAW_BOARD_ATK_DNESP32S3_BOX
    bool "ATK-DNESP32S3-BOX (ES8311 + i80 ST7789 320x240)"
    help
        Alientek ESP32-S3 development box with ES8311 codec, XL9555 IO expander,
        and 320x240 parallel-interface ST7789 display.

config BBCLAW_BOARD_WS_AMOLED_206
    bool "Waveshare ESP32-S3-Touch-AMOLED-2.06 (ES8311 + QSPI CO5300 410x502)"
    help
        Waveshare retail board with 2.06" QSPI AMOLED (CO5300/SH8601), FT3168
        touch, ES8311 codec, and AXP2101 PMIC. Octal PSRAM — switch boards via
        make set-board so the sdkconfig.board overlay is applied. See ADR-040.

config BBCLAW_BOARD_LICHUANG_SZP
    bool "嘉立创·实战派 ESP32-S3 (ES8311+ES7210 + SPI ST7789 320x240 + FT6336)"
    help
        LiChuang (JLC) ShiZhanPai ESP32-S3 dev board: ES8311 DAC + ES7210 mic
        ADC, SPI ST7789 320x240, FT6336 touch, PCA9557 IO expander (LCD CS +
        PA enable). Octal PSRAM — switch via make set-board so the
        sdkconfig.board overlay is applied. See design/boards/lichuang-szp-esp32s3.md.

endchoice

menu "Transport"

choice BBCLAW_TRANSPORT_PROFILE_CHOICE
    prompt "Transport Profile"
    default BBCLAW_TRANSPORT_PROFILE_LOCAL_HOME

config BBCLAW_TRANSPORT_PROFILE_LOCAL_HOME
    bool "local_home"
    help
        Directly connect firmware to the local bbclaw-adapter over HTTP.

config BBCLAW_TRANSPORT_PROFILE_CLOUD_SAAS
    bool "cloud_saas"
    help
        Send firmware traffic to BBClaw Cloud. Cloud terminates audio and ASR,
        then relays transcript/reply through Home Adapter.

config BBCLAW_TRANSPORT_PROFILE_LOCAL_HOME_V2
    bool "local_home_v2 (bbwire/2)"
    help
        Directly connect firmware to the local adapter_v2 over the bbwire/2
        WebSocket protocol (/v2/dev/ws): one socket, opcode-typed frames, binary
        audio with no base64. Coexists with local_home (v1); pick per build until
        the runtime adapter picker lands. See adapter_v2/docs/device-protocol.md.

endchoice

config BBCLAW_ADAPTER_BASE_URL
    string "Local Adapter Base URL"
    depends on BBCLAW_TRANSPORT_PROFILE_LOCAL_HOME
    default "http://192.168.10.26:18080"

config BBCLAW_ADAPTER_V2_BASE_URL
    string "Adapter v2 Base URL (bbwire/2)"
    depends on BBCLAW_TRANSPORT_PROFILE_LOCAL_HOME_V2
    default "ws://192.168.16.204:18090"
    help
        Base URL of the adapter_v2 server; the device dials <base>/v2/dev/ws.
        Use ws:// on the LAN, wss:// through a TLS front. The default points at a
        dev Mac running `make -C adapter_v2 run`.

config BBCLAW_CLOUD_BASE_URL
    string "Cloud Base URL"
    depends on BBCLAW_TRANSPORT_PROFILE_CLOUD_SAAS
    default "http://bbclaw.daboluo.cc"

config BBCLAW_ENABLE_TTS_PLAYBACK
    bool "Enable TTS Playback"
    default y if BBCLAW_TRANSPORT_PROFILE_CLOUD_SAAS
    default n
    help
        Play back TTS audio from Cloud or Adapter after receiving a reply.

config BBCLAW_ENABLE_DISPLAY_PULL
    bool "Enable Display Pull"
    default y if BBCLAW_TRANSPORT_PROFILE_CLOUD_SAAS
    default n
    help
        Poll Cloud or Adapter for display tasks and show them on screen.

endmenu

menu "Device Monitor"

config BBCLAW_DEVICE_MONITOR
    bool "Enable Device Monitor (USB screenshot + key injection)"
    default y
    help
        Expose a USB binary protocol channel for the bbclaw-adapter host tool
        to capture screenshots and inject navigation key events. Intended for
        development builds. Disable for release firmware to remove the entire
        subsystem and its TinyUSB footprint.

        See design/decisions/ADR-015-device-monitor-over-usb.md for the
        protocol and architecture rationale.

endmenu

menu "Wi-Fi"

config BBCLAW_WIFI_SSID
    string "Default Wi-Fi SSID"
    default ""
    help
        Optional compile-time fallback Wi-Fi SSID. Firmware tries saved slots
        first, then this SSID/password pair if configured.

config BBCLAW_WIFI_PASSWORD
    string "Default Wi-Fi Password"
    default ""
    help
        Optional compile-time fallback Wi-Fi password paired with Default
        Wi-Fi SSID.

config BBCLAW_WIFI_RECONNECT_BACKOFF_MIN_MS
    int "Auto-reconnect initial backoff interval (ms)"
    default 5000
    range 1000 60000
    help
        When the device loses Wi-Fi during runtime, it will attempt to
        reconnect using an exponential backoff timer. This sets the first
        retry interval in milliseconds (default: 5000 ms = 5 s).

config BBCLAW_WIFI_RECONNECT_BACKOFF_MAX_MS
    int "Auto-reconnect maximum backoff interval (ms)"
    default 300000
    range 10000 3600000
    help
        Maximum backoff interval for the exponential backoff reconnect
        timer in milliseconds (default: 300000 ms = 5 min).

endmenu

endmenu
```
